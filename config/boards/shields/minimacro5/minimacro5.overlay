#include <dt-bindings/zmk/matrix_transform.h>
/ {
	chosen {
		zmk,kscan = &kscan0;
		zmk,matrix_transform = &default_transform;
	};

		default_transform: keymap_transform_0 {
		compatible = "zmk,matrix-transform";
		columns = <5>;
		rows = <1>;
		map = <
		RC(0,0)  RC(0,1)  RC(0,2)  RC(0,3)  RC(0,4)
		>;
	};

	kscan0: kscan_0 {
		compatible = "zmk,kscan-gpio-direct";
		label = "KSCAN";
		input-gpios
			= <&pro_micro 21 (GPIO_ACTIVE_LOW | GPIO_PULL_UP)>
			, <&pro_micro 10 (GPIO_ACTIVE_LOW | GPIO_PULL_UP)>
			, <&pro_micro 16 (GPIO_ACTIVE_LOW | GPIO_PULL_UP)>
			, <&pro_micro 6 (GPIO_ACTIVE_LOW | GPIO_PULL_UP)>
			, <&pro_micro 8 (GPIO_ACTIVE_LOW | GPIO_PULL_UP)>
			;

	};

	// TODO: Per-key LED node(s)
};