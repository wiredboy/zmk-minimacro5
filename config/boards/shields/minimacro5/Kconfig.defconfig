## config/boards/shields/minimacro5/Kconfig.defconfig
```kconfig
if SHIELD_MINIMACRO5

config ZMK_KEYBOARD_NAME
    default "Mini Macro 5"

endif
```

## config/boards/shields/minimacro5/Kconfig.shield
```kconfig
# Copyright (c) 2022 Ramon Ramos
# SPDX-License-Identifier: MIT

config SHIELD_MINIMACRO5
    def_bool $(shields_list_contains,minimacro5)
```
